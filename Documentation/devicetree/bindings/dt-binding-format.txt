## Documentation/devicetree/bindings/dt-binding-format.txt
```
--------------------------
Device Tree Binding Format
--------------------------

Background
----------

DT bindings historically were written as text in prose format which
led to issues in usability of that source documentation. Some of
these issues include the need to programmatically process binding
source documentation to do DTS validation, perform mass updates to
format/style, and to generate publishable documentation in HTML or
PDF form.

Overview
--------

The DT binding format is based on the YAML text markup language.
Although there are many text markup options available, YAML
fulfills all requirements considered for a DT binding source format
which include:

1) Must be human readable
2) Must be easily translated to other data formats (XML, JSON, etc).
3) Must have sufficient tools and libraries to enable developers to
   build new tools for DT binding processing
4) Must have a complete spec to refer to syntax

YAML is documentated in the specification found at
http://www.yaml.org/spec/1.2/spec.html

The required YAML DT binding tag format and syntax are defined in
the following sections.

YAML DT Binding Syntax
----------------------

* Lines starting with "#" are comments and not part of the binding itself
* "%YAML 1.2" starts a file, indicating the version of YAML in use
* "---" starts a binding document
* "..." ends a binding document
* Multiple binding documents may exist in a single file
* Tabs are not permitted
* Scope is denoted by indentation of two spaces
* Key value pairs are denoted by "key: value"
* Sequences are denoted by "- "
* Scalar values may convert newlines to spaces and preserve blank
  lines for long description formatting using ">"
* Scalar values may escape all reserved characters and preserve
  newlines by using "|" to denote literal style

For additional information on YAML syntax, refer to the specification
at http://www.yaml.org/spec/1.2/spec.html

YAML DT Binding Format
----------------------

The following YAML types are supported in the DT binding format:

* [R] id: unique identifier in property form (e.g. skel-device)

* [R] title: title of the binding

* [O] maintainer: sequence of maintainers
      [R] name: name and email of maintainer or mailing list in RFC822
                form.

* [O] description: full description of the binding

* [O] compatible: sequence of valid compatible descriptors
      [R] name: the compatible string surrounded in double quotes
      [O] deprecated: a deprecated compatible string surrounded in
                      double quotes
      [O] description: description of the compatible string

* [O] required: sequence of required properties:
      [R] name: name of the property surrounded in double quotes
      [R] description: description of the property
      [O] reference: optional reference to a binding id

* [O] optional: sequence of optional properties:
      [R] name: name of the property surrounded in double quotes
      [R] description: description of the property
      [O] reference: optional reference to a binding id

* [O] deprecated: sequence of deprecated properties:
      [R] name: name of the property surrounded in double quotes
      [R] description: description of the property
      [O] reference: optional reference to a binding id

* [R] example: sequence of examples:
      [R] dts: DT source of example usage. The example text must use
               literal style ("|") so that it retains indentation and
               newlines.
      [O] description: description of the example

Note: [R] and [O] denote required and optional fields, respectively.

Skeleton Binding
----------------

The skeleton.yaml binding found in the top of the DT binding tree
is the canonical example of syntax and format to use when writing
a DT binding document. It is maintained with the latest formatting
conventions, making it the best starting point when writing a new DT
binding.
```

## Documentation/devicetree/bindings/eeprom.yaml
```yaml
%YAML 1.2
---
id: eeprom-i2c

title: EEPROMs (I2C)

compatible:
  - name: "<manufacturer>,24c00"
  - name: "<manufacturer>,24c01"
  - name: "<manufacturer>,24c02"
  - name: "<manufacturer>,24c04"
  - name: "<manufacturer>,24c08"
  - name: "<manufacturer>,24c16"
  - name: "<manufacturer>,24c32"
  - name: "<manufacturer>,24c64"
  - name: "<manufacturer>,24c128"
  - name: "<manufacturer>,24c256"
  - name: "<manufacturer>,24c512"
  - name: "<manufacturer>,24c1024"
  - name: "<manufacturer>,spd"

required:
  - name: "reg"
    description: the I2c address of the EEPROM

optional:
  - name: "pagesize"
    description: >
      the length of the pagesize for writing. Please consult the
      manual of your device, that value varies a lot. A wrong value
      may result in data loss! If not specified, a safety value of
      '1' is used which will be very slow.
  - name: "read-only"
    description: >
      this parameterless property disables writes to the eeprom

example:
  - dts: |
      eeprom@52 {
              compatible = "atmel,24c32";
              reg = <0x52>;
              pagesize = <32>;
       };
...
```

## Documentation/devicetree/bindings/misc/sram.txt
```
Generic on-chip SRAM

Simple IO memory regions to be managed by the genalloc API.

Required properties:

- compatible : sram

- reg : SRAM iomem address range

Optional properties:

- alloc-order : Minimum allocation order for the SRAM pool

Examples:

sram: sram@5c000000 {
	compatible = "sram";
	reg = <0x5c000000 0x40000>; /* 256 KiB SRAM at address 0x5c000000 */
};

sram: sram@5c000000 {
	compatible = "sram";
	reg = <0x5c000000 0x40000>; /* 256 KiB SRAM at address 0x5c000000 */
	alloc-order = <9>; /* Minimum 512 byte allocation */
};
```

## Documentation/devicetree/bindings/phy/phy-bindings.yaml
```yaml
%YAML 1.2
---
id: phy-device

title: PHY device

description: >
  This document explains only the device tree data binding.  For general
  information about PHY subsystem refer to Documentation/phy.txt

required:
  - name: "#phy-cells"
    description: >
      number of cells in a PHY specifier. The meaning of all those
      cells is defined by the binding for the phy node. The PHY
      provider can use the values in cells to find the appropriate
      PHY.

optional:
  - name: "phy-supply"
    description: >
      phandle to a regulator that provides power to the PHY. This
      regulator will be managed during the PHY power on/off sequence.

example:
  - dts: |
      phys: phy {
          compatible = "xxx";
          reg = <...>;
          .
          .
          #phy-cells = <1>;
          .
          .
      };
    description: >
      Describes an IP block (PHY provider) that implements 2 different
      PHYs. In order to differentiate between these 2 PHYs, an
      additional specifier should be given while trying to get a
      reference to it.
...

---
id: phy-user

title: PHY user

required:
  - name: "phys"
    description: >
      the phandle for the PHY device (used by the PHY subsystem)
  - name: "phy-names"
    description: >
      the names of the PHY corresponding to the PHYs present in the
      *phys* phandle

example:
  - dts: |
      usb1: usb_otg_ss@xxx {
          compatible = "xxx";
          reg = <xxx>;
          .
          .
          phys = <&usb2_phy>, <&usb3_phy>;
          phy-names = "usb2phy", "usb3phy";
          .
          .
      };
    description: >
       Represents a controller that uses two PHYs, one for usb2 and one
       for usb3.

  - dts: |
      usb2: usb_otg_ss@xxx {
          compatible = "xxx";
          reg = <xxx>;
          .
          .
          phys = <&phys 1>;
          phy-names = "usbphy";
          .
          .
      };
    description: >
      Represents a controller that uses one of the PHYs of the PHY
      provider device defined previously. Note that the phy handle
      has an additional specifier "1" to differentiate between the
      two PHYs.
...
```

## Documentation/devicetree/bindings/phy/ti-phy.yaml
```yaml
%YAML 1.2
---
id: omap-control-phy

title: OMAP Control PHY

compatible:
  - name: "ti,control-phy-otghs"
    description: if it has otghs_control mailbox register as on OMAP4.
  - name: "ti,control-phy-usb2"
    description: if it has Power down bit in control_dev_conf register
                 e.g. USB2_PHY on OMAP5.
  - name: "ti,control-phy-pipe3"
    description: if it has DPLL and individual Rx & Tx power control
                 e.g. USB3 PHY and SATA PHY on OMAP5.
  - name: "ti,control-phy-pcie"
    description: for pcie to support external clock for pcie and to
                 set PCS delay value. e.g. PCIE PHY in DRA7x
  - name: "ti,control-phy-usb2-dra7"
    description: if it has power down register like USB2 PHY on DRA7
                 DRA7 platform.
  - name: "ti,control-phy-usb2-am437"
    description: if it has power down register like USB2 PHY on AM437
                 platform.
required:
  - name: "reg"
    description: register ranges as listed in the reg-names property
  - name: "reg-names"
    description: >
                 "otghs_control" for control-phy-otghs "power",
                 "pcie_pcs" and "control_sma" for control-phy-pcie
                 "power" for all other types

example:
  - dts: |
      omap_control_usb: omap-control-usb@4a002300 {
              compatible = "ti,control-phy-otghs";
              reg = <0x4a00233c 0x4>;
              reg-names = "otghs_control";
      };
...

---
id: omap-usb2-phy

title: OMAP USB2 PHY

compatible:
  - name: "ti,omap-usb2"

required:
  - name: "reg"
    description: >
                 Address and length of the register set for the device.
  - name: "#phy-cells"
    description: >
                 determine the number of cells that should be given in
                 the phandle while referencing this phy.
    reference: phy-device
  - name: "clocks"
    description: >
                 a list of phandles and clock-specifier pairs, one for
                 each entry in clock-names.
    reference: clock-consumer
  - name: "clock-names"
    description: >
                 should include:
                 * "wkupclk" - wakeup clock.
                 * "refclk" - reference clock (optional).
    reference: clock-consumer

optional:
  - name: "ctrl-module"
    description: >
                 phandle of the control module used by PHY driver to
                 power on the PHY.

example:
  - dts: |
      usb2phy@4a0ad080 {
                compatible = "ti,omap-usb2";
                reg = <0x4a0ad080 0x58>;
                ctrl-module = <&omap_control_usb>;
                #phy-cells = <0>;
                clocks = <&usb_phy_cm_clk32k>, <&usb_otg_ss_refclk960m>;
                clock-names = "wkupclk", "refclk";
      };
    description: >
                 This is usually a subnode of ocp2scp to which it is
                 connected.
...

---
id: ti-pipe3-phy

title: TI Pipe3 PHY

compatible:
  - name: "ti,phy-usb3"
  - name: "ti,phy-pipe3-sata"
  - name: "ti,phy-pipe3-pcie"
  - deprecated: "ti,omap-usb3"

required:
  - name: "reg"
    description: >
                 Address and length of the register set for the device.
  - name: "reg-names"
    description: >
                 The names of the register addresses corresponding to
                 the registers filled in "reg".
  - name: "#phy-cells"
    description: >
                 determine the number of cells that should be given in
                 the phandle while referencing this phy.
    reference: phy-device
  - name: "clocks"
    description: >
                 a list of phandles and clock-specifier pairs, one for
                 each entry in clock-names.
    reference: clock-consumer
  - name: "clock-names"
    description: >
                 should include:
                 * "wkupclk" - wakeup clock.
                 * "sysclk" - system clock.
                 * "refclk" - reference clock.
                 * "dpll_ref" - external dpll ref clk
                 * "dpll_ref_m2" - external dpll ref clk
                 * "phy-div" - divider for apll
                 * "div-clk" - apll clock
    reference: clock-consumer

optional:
  - name: "ctrl-module"
    description: >
                 phandle of the control module used by PHY driver to
                 power on the PHY.
  - name: "id"
    description: >
                 If there are multiple instance of the same type, in
                 order to differentiate between each instance "id"
                 can be used (e.g., multi-lane PCIe PHY). If "id" is
                 not provided, it is set to default value of '1'.

example:
  - dts: |
      usb3phy@4a084400 {
              compatible = "ti,phy-usb3";
              reg = <0x4a084400 0x80>,
                    <0x4a084800 0x64>,
                    <0x4a084c00 0x40>;
              reg-names = "phy_rx", "phy_tx", "pll_ctrl";
              ctrl-module = <&omap_control_usb>;
              #phy-cells = <0>;
              clocks = <&usb_phy_cm_clk32k>,
                       <&sys_clkin>,
                       <&usb_otg_ss_refclk960m>;
              clock-names = "wkupclk",
                            "sysclk",
                            "refclk";
      };
    description: >
                 This is usually a subnode of ocp2scp to which it is
                 connected.
...
```

## Documentation/devicetree/bindings/skeleton.yaml
```yaml
%YAML 1.2
---
id: skel-device

title: Skeleton Device

maintainer:
  - name: Skeleton Person <skel@kernel.org>

description: >
  The Skeleton Device binding represents the SK11 device produced by
  the Skeleton Corporation. The binding can also support compatible
  clones made by second source vendors.

compatible:
  - name: "skel,sk11"
  - name: "faux,fx11"
    description: A clone of the original sk11 device

required:
  - name: "reg"
    description: chip select address of skeleton device
    reference: spi-slave
  - name: "spi-max-frequency"
    description: >
      Maximum SPI clocking speed of skeleton device in Hz, must be
      1000000
    reference: spi-slave

optional:
  - name: "spi-cs-high"
    description: >
      Set if skeleton device configuration straps are set for chip
      select polarity high
    reference: spi-slave

deprecated:
  - name: "skel,deprecated1"
    description: >
      First of two deprecated properties.
  - name: "skel,deprecated2"
    description: >
      Second of two deprecated properties.

example:
  - dts: |
      sk11@0 {
              compatible = "skel,sk11";
              reg = <0>;
              spi-max-frequency = <1000000>;
              spi-cs-high;
      };
...

---
id: skel-mini

title: Skeleton Mini Device

maintainer:
  - name: Rogue Developer <rogue@gmail.com>

description: >
  The Skeleton Mini Device binding represents the SK47x series devices
  produced by the Skeleton Corporation.

compatible:
  - name: "skel,sk472"
  - name: "skel,sk473"
  - name: "skel,sk474"
  - deprecated: "skel,sk47x"

required:
  - name: "reg"
    description: offset and length of the registers

optional:
  - name: "skel,sync-mode"
    description: Enable synchronous transfer mode

example:
  - dts: |
      sk472@beef0000 {
              compatible = "skel,sk472";
              reg = <0xbeef0000 0x100>;
      };
    description: >
      Demonstrates an SK472 in normal mode.

  - dts: |
      sk474@dead0000 {
              compatible = "skel,sk474";
              reg = <0xdead0000 0x100>;
              skel,sync-mode;
      };
    description: >
      Demonstrates an SK474 in synchronous mode.
...
```
